## Documentation/devicetree/bindings/iommu/qcom,iommu.txt
```
* QCOM IOMMU Implementation

Qualcomm "B" family devices which are not compatible with arm-smmu have
a similar looking IOMMU but without access to the global register space.
This is modelled as separate IOMMU devices which have just a single
master.

** Required properties:

- compatible    : Should be one of:

                        "qcom,msm8916-iommu-context-bank"

                  depending on the particular implementation and/or the
                  version of the architecture implemented.

- reg           : Base address and size of the SMMU.  And optionally,
                  if present, the "smmu_local_base"

- interrupts    : The context fault irq.

- #iommu-cells  : Must be 0

- qcom,iommu-ctx-asid   : context ASID

- qcom,iommu-secure-id  : secure-id

- clocks        : The interface clock (iface_clk) and bus clock (bus_clk)

** Examples:

	mdp_iommu: iommu-context-bank@1e24000 {
		compatible = "qcom,msm8916-iommu-context-bank";
		reg = <0x1e24000 0x1000
			0x1ef0000 0x3000>;
		reg-names = "iommu_base", "smmu_local_base";
		interrupts = <GIC_SPI 70 0>;
		qcom,iommu-ctx-asid = <4>;
		qcom,iommu-secure-id = <17>;
		#iommu-cells = <0>;
		clocks = <&gcc GCC_SMMU_CFG_CLK>,
			 <&gcc GCC_APSS_TCU_CLK>;
		clock-names = "iface_clk", "bus_clk";
		status = "okay";
	};
```

## Documentation/devicetree/bindings/thermal/qcom-spmi-temp-alarm.txt
```
Qualcomm QPNP PMIC Temperature Alarm

QPNP temperature alarm peripherals are found inside of Qualcomm PMIC chips
that utilize the Qualcomm SPMI implementation. These peripherals provide an
interrupt signal and status register to identify high PMIC die temperature.

Required properties:
- compatible:      Should contain "qcom,spmi-temp-alarm".
- reg:             Specifies the SPMI address and length of the controller's
                   registers.
- interrupts:      PMIC temperature alarm interrupt.
- #thermal-sensor-cells: Should be 0. See thermal.txt for a description.

Optional properties:
- io-channels:     Should contain IIO channel specifier for the ADC channel,
                   which report chip die temperature.
- io-channel-names: Should contain "thermal".
- stage2-shutdown-disabled: boolean to disable a partial shutdown of the PMIC
                            when the temperature reaches stage 2

Example:

	pm8941_temp: thermal-alarm@2400 {
		compatible = "qcom,spmi-temp-alarm";
		reg = <0x2400 0x100>;
		interrupts = <0 0x24 0 IRQ_TYPE_EDGE_RISING>;
		#thermal-sensor-cells = <0>;
		stage2-shutdown-disabled;

		io-channels = <&pm8941_vadc VADC_DIE_TEMP>;
		io-channel-names = "thermal";
	};

	thermal-zones {
		pm8941 {
			polling-delay-passive = <250>;
			polling-delay = <1000>;

			thermal-sensors = <&pm8941_temp>;

			trips {
				passive {
					temperature = <1050000>;
					hysteresis = <2000>;
					type = "passive";
				};
				alert {
					temperature = <125000>;
					hysteresis = <2000>;
					type = "hot";
				};
				crit {
					temperature = <145000>;
					hysteresis = <2000>;
					type = "critical";
				};
			};
		};
	};
```
